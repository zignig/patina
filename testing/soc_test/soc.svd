# soc register map
Vendor: amaranth-soc
TODO device.description
Address unit: 32 bits
Registers are 16-bit, read-write, reset 0x0 unless marked. A register's access mark holds for its fields unless they carry their own. Offsets are from the block's base; lines under a group give offsets from that group; [hi:lo] are bit positions; {n}, {i} and the like mark numbered series; 'fields as' and 'values as' point back to an identical list; <NAME> marks a mode.

## Memory map
0x00005000 SIMPLE size 0x2
0x00005004 WIDGET1 size 0x4
0x00005008 WIDGET2 size 0x4
0x0000500C COUNTER size 0x4
0x00005010 COUNTER2 size 0x4
0x00005100 SERIAL size 0x100

## Further device data
memoryRegions:
  RAM baseAddress=0x00000000 size=0x00004000
  BOOTROM baseAddress=0x00004000 size=0x00001000

## SIMPLE
Base 0x00005000
0x00 test
  [7:0] value — simple value register field
  [7:0] gorf — simple gorf register field

## WIDGET1
Base 0x00005004
0x00 config 13-bit
  [0] active — widget1 active register field
  [3:0] speed — widget1 speed register field
  [7:0] stuff — widget1 stuff register field
0x01 test
  [7:0] bork — widget1 bork register field
  [7:0] awesome — widget1 awesome register field

## WIDGET2
Base 0x00005008
0x00 config 13-bit
  [0] active — widget2 active register field
  [3:0] speed — widget2 speed register field
  [7:0] stuff — widget2 stuff register field
0x01 test
  [7:0] bork — widget2 bork register field
  [7:0] awesome — widget2 awesome register field

## COUNTER
Base 0x0000500C
0x00 enable 1-bit
  [0] enable — counter enable register field
0x01 counter ro
  [15:0] value — counter value register field
0x02 overflow
  [15:0] value — counter value register field
0x03 prescale
  [15:0] value — counter value register field

## COUNTER2
Base 0x00005010
0x00 enable 1-bit
  [0] enable — counter2 enable register field
0x01 counter ro
  [15:0] value — counter2 value register field
0x02 overflow
  [15:0] value — counter2 value register field
0x03 prescale
  [15:0] value — counter2 value register field

## SERIAL
Base 0x00005100
0x00 CKD 32-bit
  [31:0] divisor — serial divisor register field
0x01 RXS 1-bit ro
  [0] rdy — serial rdy register field
0x02 RXD 10-bit ro
  [7:0] data — serial data register field
  [0] err_overflow — serial err_overflow register field
  [0] err_frame — serial err_frame register field
0x03 TXS 1-bit ro
  [0] rdy — serial rdy register field
0x04 TXD 8-bit wo
  [7:0] data — serial data register field
